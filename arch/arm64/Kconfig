## arch/arm64/Kconfig
```kconfig
# Kconfig - ARM64 architecture configuration options

#
# SPDX-License-Identifier: Apache-2.0
#
# Copyright 2019 Broadcom
#


menu "ARM64 Options"
	depends on ARM64

source "arch/arm64/core/Kconfig"

config ARCH
	default "arm64"

endmenu
```

## arch/arm64/core/Kconfig
```kconfig
# Kconfig - ARM64 core configuration options

#
# Copyright 2019 Broadcom
# The term "Broadcom" refers to Broadcom Inc. and/or its subsidiaries.
#
# SPDX-License-Identifier: Apache-2.0
#

config CPU_CORTEX_A
	bool
	select ARMV8_A
	select THREAD_STACK_INFO
	help
	  This option signifies the use of a CPU of the Cortex-A family.

if CPU_CORTEX_A

config ARMV8_A
	bool
	select ATOMIC_OPERATIONS_BUILTIN

endif #CPU_CORTEX_A
```

## boards/arm64/bcm958742k/Kconfig.board
```kconfig
#
# SPDX-License-Identifier: Apache-2.0
#
# Copyright 2019 Broadcom
#

config BOARD_BRCM_STINGRAY_BCM958742K
	bool "Broadcom Stingray SoC bcm958742k board"
	depends on SOC_BCM58742
```

## boards/arm64/bcm958742k/Kconfig.defconfig
```kconfig
# SPDX-License-Identifier: Apache-2.0
#
# Copyright 2019 Broadcom
#

if BOARD_BRCM_STINGRAY_BCM958742K

config BOARD
	default "bcm958742k"

endif # BOARD_BRCM_STINGRAY_BCM958742K
```

## boards/arm64/bcm958742k/bcm958742k_defconfig
```kconfig
# SPDX-License-Identifier: Apache-2.0

CONFIG_ARM64=y
CONFIG_SOC_FAMILY_BRCM_IPROC=y
CONFIG_SOC_SERIES_STINGRAY=y
CONFIG_SOC_BCM58742=y
CONFIG_BOARD_BRCM_STINGRAY_BCM958742K=y

CONFIG_XIP=n
CONFIG_MAIN_STACK_SIZE=2048
CONFIG_INIT_STACKS=y

CONFIG_SCHED_MULTIQ=y
CONFIG_SCHED_DUMB=n
CONFIG_BOOT_BANNER=y

CONFIG_CONSOLE=y
CONFIG_SERIAL=y
CONFIG_UART_NS16550=y
CONFIG_UART_CONSOLE=y
CONFIG_UART_NS16550_PORT_0=y
CONFIG_CONSOLE_HANDLER=n

CONFIG_NUM_PREEMPT_PRIORITIES=0
CONFIG_SYSTEM_WORKQUEUE_PRIORITY=-2
CONFIG_HEAP_MEM_POOL_SIZE=16384
CONFIG_THREAD_NAME=y

CONFIG_SHELL=y
```

## soc/arm64/brcm_iproc/Kconfig
```kconfig
#
# Copyright 2019 Broadcom
# The term "Broadcom" refers to Broadcom Inc. and/or its subsidiaries.
#
# SPDX-License-Identifier: Apache-2.0
#

config SOC_FAMILY_BRCM_IPROC
	bool
	# omit prompt to signify a "hidden" option
	default n

if SOC_FAMILY_BRCM_IPROC
config SOC_FAMILY
	string
	default "brcm_iproc"
endif

gsource "soc/arm64/brcm_iproc/*/Kconfig.soc"
```

## soc/arm64/brcm_iproc/stingray/Kconfig.defconfig.series
```kconfig
#
# Copyright 2019 Broadcom
# The term "Broadcom" refers to Broadcom Inc. and/or its subsidiaries.
#
# SPDX-License-Identifier: Apache-2.0
#

if SOC_SERIES_STINGRAY

gsource "soc/arm64/brcm_iproc/stingray/Kconfig.defconfig.stingray*"

config SOC_SERIES
	default "stingray"

config SYS_CLOCK_HW_CYCLES_PER_SEC
	int
	default 125000000

endif # SOC_SERIES_STINGRAY
```

## soc/arm64/brcm_iproc/stingray/Kconfig.defconfig.stingray_bcm58742
```kconfig
#
# Copyright 2019 Broadcom
# The term "Broadcom" refers to Broadcom Inc. and/or its subsidiaries.
#
# SPDX-License-Identifier: Apache-2.0
#

if SOC_BCM58742

config SOC
	default "BCM58742"

endif # SOC_BCM58742
```

## soc/arm64/brcm_iproc/stingray/Kconfig.series
```kconfig
#
# Copyright 2019 Broadcom
# The term "Broadcom" refers to Broadcom Inc. and/or its subsidiaries.
#
# SPDX-License-Identifier: Apache-2.0
#

config SOC_SERIES_STINGRAY
	bool "Broadcom Stingray Series"
	select SOC_FAMILY_BRCM_IPROC
	select CPU_CORTEX_A
	select ARM_GENERIC_TIMER
	select GICV3
	help
	 Enable support for Broadcom Stingray Series
```

## soc/arm64/brcm_iproc/stingray/Kconfig.soc
```kconfig
#
# Copyright 2019 Broadcom
# The term "Broadcom" refers to Broadcom Inc. and/or its subsidiaries.
#
# SPDX-License-Identifier: Apache-2.0
#

choice
prompt "Broadcom Stingray SoC"
depends on SOC_SERIES_STINGRAY

config SOC_BCM58742
	bool "Broadcom BCM58742"
endchoice
```

## soc/arm64/brcm_vk/valkyrie/Kconfig.defconfig.series
```kconfig
#
# Copyright 2019 Broadcom
# The term "Broadcom" refers to Broadcom Inc. and/or its subsidiaries.
#
# SPDX-License-Identifier: Apache-2.0
#

if SOC_SERIES_VALKYRIE

gsource "soc/arm64/brcm_vk/valkyrie/Kconfig.defconfig.valkyrie*"

config SOC_SERIES
	default "valkyrie"

config SYS_CLOCK_HW_CYCLES_PER_SEC
	int
	default 25000000

endif # SOC_SERIES_VALKYRIE
```

## soc/arm64/brcm_vk/valkyrie/Kconfig.series
```kconfig
#
# Copyright 2019 Broadcom
# The term "Broadcom" refers to Broadcom Inc. and/or its subsidiaries.
#
# SPDX-License-Identifier: Apache-2.0
#

config SOC_SERIES_VALKYRIE
	bool "Broadcom Valkyrie Series"
	select SOC_FAMILY_BRCM_VK
	select CPU_CORTEX_A
	select ARM_GENERIC_TIMER
	select GICV3
	help
	 Enable support for Broadcom Valkyrie Series
```
